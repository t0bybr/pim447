## Kconfig
```kconfig
# SPDX-License-Identifier: MIT
# Copyright (c) 2024 t0bybr

config ZMK_PIMORONI_PIM447
  bool "Pimoroni PIM447 Trackball support"
  select ZMK_MOUSE
  select I2C
  select GPIO
  help
    Enable driver for Pimoroni Trackball.

config ZMK_PIMORONI_PIM447_LOG_LEVEL
  int "PIM447 log level"
  default 3
  help
    Zephyr log level for the PIM447 driver. 0=NONE, 1=ERR, 2=WRN, 3=INF, 4=DBG.

if ZMK_PIMORONI_PIM447

  config ZMK_PIMORONI_PIM447_AUTOMOUSE_TIMEOUT_MS
    int "Amount of milliseconds the mouse layer will be active after using the trackball"
    default 400

  config ZMK_PIM447_BEHAVIORS
    bool "Enable Pimoroni PIM447 Trackball Actions behavior"
    depends on ZMK_PIMORONI_PIM447
    select ZMK_BEHAVIORS
    default y
    help
      Enable Pimoroni PIM447 Trackball behaviors.

endif # ZMK_PIMORONI_PIM447
```

## config/boards/shields/pim447_nano/Kconfig.defconfig
```kconfig
# SPDX-License-Identifier: MIT

if SHIELD_PIM447_NANO

config ZMK_KEYBOARD_NAME
    default "PIM447"

config ZMK_POINTING
    default y

config ZMK_PIMORONI_PIM447
    default y

config ZMK_PIM447_BEHAVIORS
    default y

endif
```

## config/boards/shields/pim447_test/Kconfig.defconfig
```kconfig
if SHIELD_PIM447_TEST

config ZMK_KEYBOARD_NAME
    default "PIM447 Test"

config ZMK_MOUSE
    default y

config ZMK_PIMORONI_PIM447
    default y

config ZMK_PIM447_BEHAVIORS
    default y

endif
```

## dts/bindings/behaviors/zmk,behavior-pim447.yaml
```yaml
# Copyright (c) 2021 The ZMK Contributors
# SPDX-License-Identifier: MIT

description: Custom behavior to adjust trackball parameters via keypresses.

compatible: "zmk,behavior-pim447"

include: one_param.yaml

properties:
  "#binding-cells":
    const: 1
    type: int
```
