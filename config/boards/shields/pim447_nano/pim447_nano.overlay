/* SPDX-License-Identifier: MIT */
/*
 * Standalone PIM447 trackball shield for a SuperMini nRF52840 (built as a
 * nice_nano//zmk target, with the I2C pinctrl overridden to this board's
 * exposed pads).
 *
 * Wiring (SuperMini nRF52840 pads):
 *   PIM447 VDD -> 3V3
 *   PIM447 GND -> GND
 *   PIM447 SDA -> D8  (P1.04)
 *   PIM447 SCL -> D9  (P1.06)
 *   PIM447 INT -> D7  (P0.11, active-low, internal pull-up)
 *
 * The nice_nano board target hardwires i2c0 to P0.17/P0.20 via PSEL, which
 * are not exposed on the SuperMini footprint, so we override the i2c0
 * pinctrl here to the pads that are actually broken out.
 */

&pinctrl {
    pim447_i2c0_default: pim447_i2c0_default {
        group1 {
            psels = <NRF_PSEL(TWIM_SDA, 1, 4)>,
                <NRF_PSEL(TWIM_SCL, 1, 6)>;
        };
    };

    pim447_i2c0_sleep: pim447_i2c0_sleep {
        group1 {
            psels = <NRF_PSEL(TWIM_SDA, 1, 4)>,
                <NRF_PSEL(TWIM_SCL, 1, 6)>;
            low-power-enable;
        };
    };
};

&i2c0 {
    status = "okay";
    clock-frequency = <I2C_BITRATE_STANDARD>;
    pinctrl-0 = <&pim447_i2c0_default>;
    pinctrl-1 = <&pim447_i2c0_sleep>;
    pinctrl-names = "default", "sleep";

    pimoroni_pim447: pimoroni_pim447@a {
        compatible = "zmk,pimoroni-pim447";
        reg = <0x0a>;
        int-gpios = <&gpio0 11 (GPIO_ACTIVE_LOW | GPIO_PULL_UP)>;
    };
};

/*
 * Route trackball input events (REL_X/Y/WHEEL/HWHEEL, BTN_0) through ZMK's
 * input listener to the USB/BLE HID mouse endpoint. Without this node the
 * driver reports into the input subsystem but nothing forwards it to HID,
 * so the host sees no movement even though the trackball works.
 */
pim447_input_listener: pim447_input_listener {
    compatible = "zmk,input-listener";
    device = <&pimoroni_pim447>;
};

/ {
    chosen {
        zmk,kscan = &kscan0;
    };

    kscan0: kscan {
        compatible = "zmk,kscan-gpio-direct";
        input-gpios = <&gpio0 31 (GPIO_ACTIVE_LOW | GPIO_PULL_UP)>;
    };
};
