/* SPDX-License-Identifier: MIT */

#include <behaviors.dtsi>
#include <behaviors/behavior_pim447.dtsi>
#include <dt-bindings/zmk/keys.h>
#include <dt-bindings/behavior_pim447.h>

/ {
    keymap {
        compatible = "zmk,keymap";

        default_layer {
            bindings = <&kp A>;
        };
    };
};
